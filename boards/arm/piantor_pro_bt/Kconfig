## boards/arm/piantor_pro_bt/Kconfig
```kconfig
# SPDX-License-Identifier: MIT

config BOARD_ENABLE_DCDC
	bool "Enable DCDC mode"
	select SOC_DCDC_NRF52X
	default y
	depends on (BOARD_PIANTOR_PRO_BT_LEFT || BOARD_PIANTOR_PRO_BT_RIGHT)

# Enable pointing for mouse keys
CONFIG_ZMK_POINTING=y

# Enable smooth scrolling, might not work on macOS
CONFIG_ZMK_POINTING_SMOOTH_SCROLLING=y
```
